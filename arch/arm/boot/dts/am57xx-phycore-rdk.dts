/*
 * Copyright (C) 2014 Texas Instruments Incorporated - http://www.ti.com/
 *
 * This program is free software; you can redistribute it and/or modify
 * it under the terms of the GNU General Public License version 2 as
 * published by the Free Software Foundation.
 */
/dts-v1/;

#include "am57xx-phycore-som.dtsi"	/* Superset - enables all SOM features */
#include "am57xx-pcm-948.dtsi"		/* Carrier Board */
#include "am57xx-phytec-lcd-018.dtsi"	/* LCD-018-070-KAP Display */
#include "am57xx-phytec-vm-0xx.dtsi"	/* PHYCAM-P Camera Adapter Boards */
#include "am57xx-phytec-wlan-wilink8.dtsi" /* WiLink8 Adapter Board */
